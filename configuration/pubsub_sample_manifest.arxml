AUTOSAR XML (schema 00050)
package /AraComPubSubSampleManifest
  communication-cluster protocol-version=1:
    ethernet physical channel LoopbackChannel
      network endpoint ProviderEndpoint: network-endpoint-addresses=ipv-4-configuration=ipv-4-address=127.0.0.1
      network endpoint ConsumerEndpoint: network-endpoint-addresses=ipv-4-configuration=ipv-4-address=127.0.0.1
  ethernet communication connector ProviderConnector
    ap application endpoint ProviderUdpEndpoint: tp-configuration=udp-tp=udp-tp-port=port-number=30509
  ethernet communication connector ConsumerConnector
    ap application endpoint ConsumerUdpEndpoint: tp-configuration=udp-tp=udp-tp-port=port-number=30510
  provided someip service instance VehicleStatusProviderInstance: service-interface-deployment={service-interface-id=4660, service-interface-version={major-version=1, minor-version=0}}, sd-server-config=initial-offer-behavior={initial-delay-min-value=20, initial-delay-max-value=200}, service-instance-id=1
    someip provided event group VehicleStatusEventGroup: event-group-id=1, event-id=32769, event-multicast-udp-port=30509, ipv-4-multicast-ip-address=239.255.0.1
  required someip service instance VehicleStatusConsumerRequirement: service-interface-deployment={service-interface-id=4660, service-interface-version={major-version=1, minor-version=0}}, sd-client-config=initial-find-behavior={initial-delay-min-value=20, initial-delay-max-value=200}
    someip required event group VehicleStatusEventGroupRequirement: event-group-id=1, event-id=32769
