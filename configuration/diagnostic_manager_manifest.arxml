AUTOSAR XML (schema 00050)
package /DiagnosticManagerManifest
  elements required-someip-service-instance={service-interface-deployment=service-interface-id=5, sd-client-config=initial-find-behavior={initial-delay-min-value=100, initial-delay-max-value=200}}:
    communication-cluster:
      ethernet physical channel MutlicastLocalhost
        network endpoint DiagnosticManagerEP: network-endpoint-addresses=ipv-4-configuration=ipv-4-address=239.0.0.1
        network endpoint ExtendedVehicleEP: network-endpoint-addresses=ipv-4-configuration=ipv-4-address=127.0.0.1
    ethernet communication connector DiagnosticManagerConn
      ap application endpoint MulticastUdp: tp-configuration=udp-tp=udp-tp-port=port-number=5555
      ap application endpoint ServerUnicastTcp: tp-configuration=tcp-tp=tcp-tp-port=port-number=8081
    diagnostic monitor interface TelematicControlModuleMonitor: diag-event-debounce-time-based={time-passed-threshold=6000, time-failed-threshold=6000}
    diagnostic event interface TelematicControlModuleEvent: dtc-number=49560
