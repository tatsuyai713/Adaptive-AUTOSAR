AUTOSAR XML (schema 4.0)
package /AdaptiveAutosar/ExecutionManifest
  4 x process design:
    RaspiEcuApp: executable=/opt/autosar_ap/user_apps_build/src/apps/basic/autosar_user_raspi_ecu, function-group=MachineFG, state=Running, startup-priority=10, startup-grace-ms=5000, termination-timeout-ms=5000
    SensorFusionApp: executable=/opt/autosar_ap/user_apps_build/src/apps/feature/ecu/sensor_fusion_app, function-group=MachineFG, state=Running, startup-priority=20, startup-grace-ms=3000, termination-timeout-ms=5000, cpu-quota-percent=25, memory-limit-bytes=67108864, depends-on=RaspiEcuApp
    DiagToolApp: executable=/opt/autosar_ap/user_apps_build/src/apps/feature/diag_tool_app, function-group=MachineFG, state=Diagnostic, startup-priority=30, startup-grace-ms=3000, termination-timeout-ms=3000
    OtaUpdateAgent: executable=/opt/autosar_ap/user_apps_build/src/apps/feature/ota_agent, function-group=UpdateFG, state=Active, startup-priority=10, startup-grace-ms=5000, termination-timeout-ms=10000, cpu-quota-percent=50, memory-limit-bytes=134217728
